## board/pixieboard/pixieduo/Kconfig
```kconfig
if TARGET_PIXIEDUO

# customer board name
config SYS_BOARD
	default "pixieduo"

config SYS_VENDOR
	    default "pixieboard"

config SYS_SOC
	default "mx6"

# customer board
config SYS_CONFIG_NAME
	default "pixieduo"

endif
```

## configs/pixieduo_defconfig
```kconfig
CONFIG_ARM=y
CONFIG_ARCH_MX6=y
CONFIG_TARGET_PIXIEDUO=y
# The *.cfg file is the setup for the memory
CONFIG_SYS_EXTRA_OPTIONS="IMX_CONFIG=board/pixieboard/pixieduo/pixieduodl.cfg,MX6DL"
# CONFIG_CMD_IMLS is not set
# CONFIG_CMD_FLASH is not set
CONFIG_SPI_FLASH=y
```
